## boards/shields/nice_view_atmos/Kconfig.shield
```kconfig
# Copyright (c) 2022 The ZMK Contributors
# SPDX-License-Identifier: MIT

config SHIELD_NICE_VIEW_ATMOS
    def_bool $(shields_list_contains,nice_view_atmos)
```
